## config/west.yml
```yaml
manifest:
  remotes:
    - name: zmkfirmware
      url-base: https://github.com/petejohanson
    - name: badjeff
      url-base: https://github.com/badjeff
  projects:
    - name: zmk
      remote: zmkfirmware
      revision: v0.3
      import: app/west.yml
    - name: zmk-pmw3610-driver
      remote: badjeff
      revision: zmk-v0.3
    - name: zmk-split-peripheral-input-relay
      remote: badjeff
      revision: zmk-v0.3
    - name: zmk-input-behavior-listener
      remote: badjeff
      revision: zmk-v0.3
  self:
    path: config
```
